#include "UART.h"

void UART_CONFIG(void)
{
	RCC->APB2ENR|=RCC_APB2ENR_USART1EN|RCC_APB2ENR_IOPAEN;
	//GPIO CONFIG REMAP 0 UART PORT PA 9,10 ,TX,RX
	GPIOA->CRH|=GPIO_CRH_MODE9_0|GPIO_CRH_MODE9_1|GPIO_CRH_CNF9_1|GPIO_CRH_CNF10_1;
	GPIOA->CRH&=~(GPIO_CRH_CNF9_0|GPIO_CRH_MODE10_0|GPIO_CRH_MODE10_1|GPIO_CRH_CNF10_0);
	GPIOA->ODR|=GPIO_ODR_ODR10;
	USART1->BRR=(12<<0)|(468<<4);
	USART1->CR1|=USART_CR1_UE|USART_CR1_TE|USART_CR1_RE;
//	RCC->APB2ENR|=RCC_APB2ENR_IOPAEN;
//	RCC->APB2ENR|=RCC_APB2ENR_IOPBEN;
//	RCC->APB1ENR|=RCC_APB1ENR_USART3EN;
//	GPIOB->CRH|=GPIO_CRH_MODE10_0|GPIO_CRH_MODE10_1|GPIO_CRH_CNF10_1|GPIO_CRH_CNF11_1;
//	GPIOB->CRH&=~(GPIO_CRH_CNF10_0|GPIO_CRH_MODE11_0|GPIO_CRH_MODE11_1|GPIO_CRH_CNF11_0);
//	GPIOB->ODR|=GPIO_ODR_ODR11;
//	USART3->BRR=(6<<0)|(234<<4);
//	USART3->CR1|=USART_CR1_UE|USART_CR1_TE|USART_CR1_RE;
}
void UART_TX (char c)
{
	USART1->DR = c;
	while (!(USART1->SR & (USART_SR_TC)));
//	USART3->DR = c;
//	while (!(USART3->SR & (USART_SR_TC)));
}
void UART_TXstring(char *c)
{
	while(*c)
	{
		UART_TX(*c++);
	}
}
char UART_RXchar(void)
{
	while(!(USART1->SR & (USART_SR_RXNE)))
		;
	return USART1->DR;
	
}
